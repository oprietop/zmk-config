## config/west.yml
```yaml
manifest:
  remotes:
    - name: zmkfirmware
      url-base: https://github.com/urob
  projects:
    - name: zmk
      remote: zmk
      revision: mouse-3.2
      import: app/west.yml
  self:
    path: config
```
